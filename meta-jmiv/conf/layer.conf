## meta-jmiv/conf/layer.conf
```bitbake
# We have a conf and classes directory, add to BBPATH
BBPATH .= ":${LAYERDIR}"

# We have recipes-* directories, add to BBFILES
BBFILES += "${LAYERDIR}/recipes-*/*/*.bb \
            ${LAYERDIR}/recipes-*/*/*.bbappend"

BBFILE_COLLECTIONS += "meta-jmiv"
BBFILE_PATTERN_meta-jmiv = "^${LAYERDIR}/"
BBFILE_PRIORITY_meta-jmiv = "6"

LAYERDEPENDS_meta-jmiv = "core"
LAYERSERIES_COMPAT_meta-jmiv = "dunfell"
```
